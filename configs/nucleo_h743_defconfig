## configs/nucleo_h743_defconfig
```kconfig
# SPDX-FileCopyrightText: 2023-2024 Ledger SAS
# SPDX-License-Identifier: Apache-2.0

CONFIG_ARCH_MCU_STM32H743=y
CONFIG_FPU_SOFTFP_ABI=y
CONFIG_BUILD_TARGET_AUTOTEST=y
CONFIG_STANDALONE_MODE=y
```
